## experiments/nfc-pn532-irq/sdkconfig.defaults
```kconfig
CONFIG_ESPTOOLPY_FLASHSIZE_16MB=y
CONFIG_ESP_CONSOLE_UART_DEFAULT=y
CONFIG_ESP_CONSOLE_SECONDARY_NONE=y
CONFIG_ESP_MAIN_TASK_STACK_SIZE=6144
CONFIG_FREERTOS_HZ=1000
```

## firmware/components/orbita_pipeline/Kconfig
```kconfig
menu "Orbita pipeline"

    config ORBITA_PIPELINE_USA_AFE
        bool "Usar el AFE (esp-sr) en el pipeline"
        default n
        help
            Activado: la captura alimenta al AFE (ring in -> feed -> AFE -> fetch) y se
            entrega su salida por on_afe. Desactivado: solo captura cruda por on_crudo.
            Es una sola opcion para todo el proyecto, asi pipeline.c y main/ nunca
            se compilan con valores distintos.

    config ORBITA_AFE_VAD_MODE
        int "VAD del AFE: modo (0 normal ... 4 el mas agresivo)"
        range 0 4
        default 0
        depends on ORBITA_PIPELINE_USA_AFE
        help
            Modo del VAD WebRTC. Mas agresivo = marca menos voz (menos falsos "hay voz"
            en silencio, pero puede comerse el inicio o el final de las palabras).
            0 es el default del AFE (marcaba voz en el 100 % de los bloques con ruido grave).

    config ORBITA_AFE_VAD_MIN_SPEECH_MS
        int "VAD del AFE: ms minimos de voz para marcar inicio (>= 32)"
        range 32 1000
        default 128
        depends on ORBITA_PIPELINE_USA_AFE

    config ORBITA_AFE_VAD_MIN_NOISE_MS
        int "VAD del AFE: ms de silencio para marcar fin de voz (>= 64)"
        range 64 3000
        default 1000
        depends on ORBITA_PIPELINE_USA_AFE
        help
            Arrastre despues de la voz: con 1000, cada tramo de voz se marca ~1 s de mas.

endmenu
```

## firmware/components/orbita_wifi/Kconfig
```kconfig
menu "Orbita WiFi"

    config ORBITA_WIFI_SSID
        string "Wi-Fi SSID (red de 2,4 GHz)"
        default ""
    config ORBITA_WIFI_PASSWORD
        string "Wi-Fi password"
        default ""
        help
            Credenciales locales: sdkconfig y firmware las contienen. No compartirlos.
    config ORBITA_WS_URI
        string "WebSocket URI del servidor (ws://IP-PC:8765)"
        default ""

    config ORBITA_WIFI_TX_POWER
        int "Potencia maxima de transmision (0 = la del driver; 8..84, unidad 0.25 dBm)"
        range 0 84
        default 0
        help
            PRUEBA de ruido audible: las rafagas de consumo del WiFi hacen "cantar" a los
            capacitores ceramicos y la placa suena. Bajar la potencia achica esas rafagas.
            8 = 2 dBm, 40 = 10 dBm, 84 = 20 dBm (el maximo). Con la notebook cerca alcanza
            con poco; si se corta la conexion, subirla. 0 no toca nada.

endmenu
```

## firmware/main/Kconfig.projbuild
```kconfig
menu "Orbita integration"
    choice ORBITA_LAB_MODE
        prompt "Modo del firmware"
        default ORBITA_LAB_WEBSOCKET
        config ORBITA_LAB_UART
            bool "Captura por UART a WAV (estudio de audio del frente Audio)"
        config ORBITA_LAB_WEBSOCKET
            bool "Prototipo: audio continuo por WebSocket y parlante"
            select ESP_WS_CLIENT_SEPARATE_TX_LOCK
    endchoice

    config ORBITA_WIFI_SSID
        string "Wi-Fi SSID"
        default ""
        depends on ORBITA_LAB_WEBSOCKET
    config ORBITA_WIFI_PASSWORD
        string "Wi-Fi password"
        default ""
        depends on ORBITA_LAB_WEBSOCKET
        help
            Credenciales locales: sdkconfig y firmware las contienen. No compartirlos.
    config ORBITA_WS_URI
        string "WebSocket URI (ws://IP-PC:8765/)"
        default ""
        depends on ORBITA_LAB_WEBSOCKET
endmenu
```
